## meta-rk3506-custom/conf/layer.conf
```bitbake
# We have a conf and classes directory, add to BBPATH
BBPATH .= ":${LAYERDIR}"

# We have recipes-* directories, add to BBFILES
BBFILES += "${LAYERDIR}/recipes-*/*/*.bb \
            ${LAYERDIR}/recipes-*/*/*.bbappend"

BBFILE_COLLECTIONS += "rk3506-custom"
BBFILE_PATTERN_rk3506-custom = "^${LAYERDIR}/"
BBFILE_PRIORITY_rk3506-custom = "10"

LAYERDEPENDS_rk3506-custom = "core \
                               openembedded-layer \
                               rockchip"

LAYERSERIES_COMPAT_rk3506-custom = "scarthgap"
```

## meta-rk3506-custom/conf/machine/include/rk3506.inc
```bitbake
# Copyright (c) 2025, Rockchip Electronics Co., Ltd
# Released under the MIT license (see COPYING.MIT for the terms)

require conf/machine/include/arm/armv7a/tune-cortexa7.inc
require conf/machine/include/rockchip-common.inc

SERIAL_CONSOLES = "115200;ttyFIQ0"

RK_SOC_FAMILY := "rk3506"

KBUILD_DEFCONFIG := "rk3506_defconfig"

# Force using u-boot-rockchip instead of standard u-boot
# This overrides the default selection based on version numbers
PREFERRED_PROVIDER_virtual/bootloader := "u-boot-rockchip"
PREFERRED_PROVIDER_u-boot := "u-boot-rockchip"

# Ensure using linux-rockchip (from Rockchip official kernel repository)
# This ensures we use the custom linux-rockchip_6.6.bb recipe which uses
# github.com/rockchip-linux/kernel.git (Rockchip official kernel)
PREFERRED_PROVIDER_virtual/kernel := "linux-rockchip"
```

## meta-rk3506-custom/conf/machine/include/rockchip-common.inc
```bitbake
# Copyright (c) 2024, Rockchip Electronics Co., Ltd
# Released under the MIT license (see COPYING.MIT for the terms)
#
# Override rockchip-common.inc to prefer kernel 6.6 instead of 6.1

# Prefer using Rockchip BSP kernel 6.6
PREFERRED_VERSION_linux-rockchip ?= "6.6%"
LINUXLIBCVERSION ?= "6.6-custom%"
```

## meta-rk3506-custom/conf/machine/rockchip-rk3506g-core-evm.conf
```bitbake
# Copyright (c) 2024, Rockchip Electronics Co., Ltd
# Released under the MIT license (see COPYING.MIT for the terms)

#@TYPE: Machine
#@NAME: RK3506G Core EVM

require conf/machine/include/rk3506.inc

KERNEL_DEVICETREE = "rockchip/rk3506g-core.dtb"

UBOOT_MACHINE = "rk3506_defconfig"
RK_UBOOT_SPL = "1"
```
